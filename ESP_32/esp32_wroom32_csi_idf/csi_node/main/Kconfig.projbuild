## ESP_32/esp32_wroom32_csi_idf/csi_node/main/Kconfig.projbuild
```kconfig
menu "EAGLE-Δ CSI Node Configuration"

config ESP_CSI_NODE_ID
    int "Node ID"
    default 3
    help
        Unique ID for this CSI node (1-4 for 4-node setup)

config ESP_WIFI_SSID
    string "WiFi SSID"
    default "BAPU_07"
    help
        WiFi SSID to connect to

config ESP_WIFI_PASSWORD
    string "WiFi Password"
    default "Bapu@2005"
    help
        WiFi password

config ESP_BACKEND_HOST
    string "Backend Host"
    default "10.159.43.174"
    help
        Backend server hostname or IP address

config ESP_BACKEND_PORT
    int "Backend Port"
    default 4032
    help
        Backend server port number

config ESP_BACKEND_PATH
    string "Backend Telemetry Path"
    default "/api/netra32/telemetry"
    help
        Backend endpoint path for telemetry

endmenu
```

## ESP_32/esp32_wroom32_csi_idf/csi_node/sdkconfig.defaults
```kconfig
CONFIG_ESP_WIFI_CSI_ENABLED=y
CONFIG_ESPTOOLPY_BAUD_921600B=y
CONFIG_ESPTOOLPY_BAUD=921600
CONFIG_ESP_CONSOLE_UART_BAUDRATE=921600

# EAGLE-Δ CSI Node Defaults
CONFIG_ESP_CSI_NODE_ID=3
CONFIG_ESP_WIFI_SSID="BAPU_07"
CONFIG_ESP_WIFI_PASSWORD="Bapu@2005"

# Recommended for CSI applications
CONFIG_ESP_DEFAULT_CPU_FREQ_MHZ_240=y
CONFIG_ESP_DEFAULT_CPU_FREQ_MHZ=240
CONFIG_COMPILER_OPTIMIZATION_PERF=y

# HTTP client and JSON support
CONFIG_ESP_HTTP_CLIENT_ENABLE=y
CONFIG_JSON_ENABLE=y
```
